## Config.in
```kconfig
source "$BR2_EXTERNAL_DT_PATH/package/expo/Config.in"
source "$BR2_EXTERNAL_DT_PATH/package/rockchip/Config.in"
source "$BR2_EXTERNAL_DT_PATH/package/testing/Config.in"
```

## configs/diasom_rk3588_defconfig
```kconfig
BR2_aarch64=y
BR2_cortex_a76_a55=y
BR2_PACKAGE_HOST_LINUX_HEADERS_CUSTOM_6_1=y
BR2_TOOLCHAIN_BUILDROOT_CXX=y
BR2_GLOBAL_PATCH_DIR="board/radxa/rock5b/patches"
BR2_TARGET_GENERIC_HOSTNAME="rock5b"
BR2_TARGET_GENERIC_ISSUE="Welcome to the rock5b board"
BR2_ROOTFS_POST_BUILD_SCRIPT="board/radxa/rock5b/post-build.sh"
BR2_ROOTFS_POST_IMAGE_SCRIPT="support/scripts/genimage.sh"
BR2_ROOTFS_POST_SCRIPT_ARGS="-c board/radxa/rock5b/genimage.cfg"
BR2_LINUX_KERNEL=y
BR2_LINUX_KERNEL_CUSTOM_GIT=y
BR2_LINUX_KERNEL_CUSTOM_REPO_URL="https://github.com/armbian/linux-rockchip.git"
BR2_LINUX_KERNEL_CUSTOM_REPO_VERSION="rk-6.1-rkr5"
BR2_LINUX_KERNEL_DEFCONFIG="rockchip_linux"
BR2_LINUX_KERNEL_CONFIG_FRAGMENT_FILES="$(BR2_EXTERNAL_DT_PATH)/board/diasom/rk3588_b2b/rk3588_linux.config"
BR2_LINUX_KERNEL_DTS_SUPPORT=y
BR2_LINUX_KERNEL_INTREE_DTS_NAME="rockchip/rk3588-rock-5b"
BR2_LINUX_KERNEL_DTB_OVERLAY_SUPPORT=y
BR2_LINUX_KERNEL_INSTALL_TARGET=y
BR2_PACKAGE_ZIP=y
BR2_PACKAGE_FIO=y
BR2_PACKAGE_IOZONE=y
BR2_PACKAGE_SPIDEV_TEST=y
BR2_PACKAGE_E2FSPROGS=y
BR2_PACKAGE_E2FSPROGS_RESIZE2FS=y
BR2_PACKAGE_OBSIDIAN_CURSORS=y
BR2_PACKAGE_DEJAVU=y
BR2_PACKAGE_KMSCUBE=y
BR2_PACKAGE_FB_TEST_APP=y
BR2_PACKAGE_MESA3D=y
BR2_PACKAGE_MESA3D_GALLIUM_DRIVER_PANFROST=y
BR2_PACKAGE_MESA3D_OSMESA_GALLIUM=y
BR2_PACKAGE_MESA3D_OPENGL_EGL=y
BR2_PACKAGE_MESA3D_OPENGL_ES=y
BR2_PACKAGE_LINUX_FIRMWARE=y
BR2_PACKAGE_LINUX_FIRMWARE_RTL_8169=y
BR2_PACKAGE_ROCKCHIP_RKBIN=y
BR2_PACKAGE_ROCKCHIP_RKBIN_TPL_FILENAME="bin/rk35/rk3588_ddr_lp4_2112MHz_lp5_2736MHz_v1.12.bin"
BR2_PACKAGE_ROCKCHIP_RKBIN_BL31_FILENAME="bin/rk35/rk3588_bl31_v1.40.elf"
BR2_TARGET_ROOTFS_EXT2=y
BR2_TARGET_ROOTFS_EXT2_4=y
BR2_TARGET_ROOTFS_EXT2_SIZE="512M"
BR2_TARGET_UBOOT=y
BR2_TARGET_UBOOT_BUILD_SYSTEM_KCONFIG=y
BR2_TARGET_UBOOT_CUSTOM_VERSION=y
BR2_TARGET_UBOOT_CUSTOM_VERSION_VALUE="2024.01"
BR2_TARGET_UBOOT_BOARD_DEFCONFIG="rock5b-rk3588"
BR2_TARGET_UBOOT_NEEDS_PYLIBFDT=y
BR2_TARGET_UBOOT_NEEDS_PYELFTOOLS=y
BR2_TARGET_UBOOT_NEEDS_OPENSSL=y
BR2_TARGET_UBOOT_NEEDS_ROCKCHIP_RKBIN=y
BR2_PACKAGE_HOST_DOSFSTOOLS=y
BR2_PACKAGE_HOST_DTC=y
BR2_PACKAGE_HOST_GENIMAGE=y
BR2_PACKAGE_HOST_MTOOLS=y
```

## configs/ds_rk3588_defconfig
```kconfig
# Architecture
BR2_aarch64=y
BR2_cortex_a76_a55=y

# Linux headers same as kernel, a 6.7 series
BR2_KERNEL_HEADERS_6_10=y

# Build
BR2_GLOBAL_PATCH_DIR="board/radxa/rock5b/patches"
# BR2_DOWNLOAD_FORCE_CHECK_HASHES=y

# Bootloader
BR2_TARGET_UBOOT=y
BR2_TARGET_UBOOT_BUILD_SYSTEM_KCONFIG=y
BR2_TARGET_UBOOT_CUSTOM_VERSION=y
BR2_TARGET_UBOOT_CUSTOM_VERSION_VALUE="2024.01"
BR2_TARGET_UBOOT_BOARD_DEFCONFIG="rock5b-rk3588"
BR2_TARGET_UBOOT_NEEDS_PYLIBFDT=y
BR2_TARGET_UBOOT_NEEDS_OPENSSL=y
BR2_TARGET_UBOOT_NEEDS_PYELFTOOLS=y
BR2_TARGET_UBOOT_NEEDS_ROCKCHIP_RKBIN=y
BR2_PACKAGE_ROCKCHIP_RKBIN=y
BR2_PACKAGE_ROCKCHIP_RKBIN_TPL_FILENAME="bin/rk35/rk3588_ddr_lp4_2112MHz_lp5_2736MHz_v1.12.bin"
BR2_PACKAGE_ROCKCHIP_RKBIN_BL31_FILENAME="bin/rk35/rk3588_bl31_v1.40.elf"

# Kernel
BR2_LINUX_KERNEL=y
# BR2_LINUX_KERNEL_CUSTOM_VERSION=y
# BR2_LINUX_KERNEL_CUSTOM_VERSION_VALUE="6.7.4"
BR2_LINUX_KERNEL_CUSTOM_GIT=y
BR2_LINUX_KERNEL_CUSTOM_REPO_URL="https://github.com/MacroGroup/linux.git"
BR2_LINUX_KERNEL_CUSTOM_REPO_VERSION="b9f29ff7b618"
BR2_LINUX_KERNEL_USE_ARCH_DEFAULT_CONFIG=y
BR2_LINUX_KERNEL_DTS_SUPPORT=y
BR2_LINUX_KERNEL_INSTALL_TARGET=y
BR2_LINUX_KERNEL_INTREE_DTS_NAME="rockchip/rk3588-rock-5b"
BR2_LINUX_KERNEL_DTB_OVERLAY_SUPPORT=y
BR2_LINUX_KERNEL_CONFIG_FRAGMENT_FILES="board/radxa/rock5b/linux.fragment"

# Filesystem
BR2_TARGET_GENERIC_HOSTNAME="rock5b"
BR2_TARGET_GENERIC_ISSUE="Welcome to the rock5b board"
BR2_TARGET_ROOTFS_EXT2=y
BR2_TARGET_ROOTFS_EXT2_4=y
BR2_TARGET_ROOTFS_EXT2_SIZE="250M"
BR2_PACKAGE_HOST_DOSFSTOOLS=y
BR2_PACKAGE_HOST_DTC=y
BR2_PACKAGE_HOST_GENIMAGE=y
BR2_PACKAGE_HOST_MTOOLS=y
BR2_ROOTFS_POST_BUILD_SCRIPT="board/radxa/rock5b/post-build.sh"
BR2_ROOTFS_POST_IMAGE_SCRIPT="support/scripts/genimage.sh"
BR2_ROOTFS_POST_SCRIPT_ARGS="-c board/radxa/rock5b/genimage.cfg"


#packages
BR2_PACKAGE_GZIP=y
BR2_PACKAGE_P7ZIP=y
BR2_PACKAGE_P7ZIP_7ZA=y
BR2_PACKAGE_UNRAR=y
BR2_PACKAGE_ZIP=y
BR2_PACKAGE_FIO=y
BR2_PACKAGE_GDB=y
BR2_PACKAGE_IOZONE=y
BR2_PACKAGE_SPIDEV_TEST=y
BR2_PACKAGE_STRESS_NG=y
BR2_PACKAGE_DOSFSTOOLS=y
BR2_PACKAGE_DOSFSTOOLS_FATLABEL=y
BR2_PACKAGE_DOSFSTOOLS_FSCK_FAT=y
BR2_PACKAGE_DOSFSTOOLS_MKFS_FAT=y
BR2_PACKAGE_E2FSPROGS=y
BR2_PACKAGE_E2FSPROGS_RESIZE2FS=y
BR2_PACKAGE_EXFATPROGS=y
BR2_PACKAGE_F2FS_TOOLS=y
BR2_PACKAGE_MMC_UTILS=y
BR2_PACKAGE_NTFS_3G=y
BR2_PACKAGE_NTFS_3G_NTFSPROGS=y
BR2_PACKAGE_OBSIDIAN_CURSORS=y
BR2_PACKAGE_DEJAVU=y
BR2_PACKAGE_DOOM_WAD=y
BR2_PACKAGE_GLMARK2=y
BR2_PACKAGE_GLSLSANDBOX_PLAYER=y
BR2_PACKAGE_GLSLSANDBOX_PLAYER_PNG=y
BR2_PACKAGE_GLSLSANDBOX_PLAYER_TESTING=y
BR2_PACKAGE_GLSLSANDBOX_PLAYER_WL=y
BR2_PACKAGE_KMSCUBE=y
BR2_PACKAGE_KMSCUBE_GSTREAMER=y
BR2_PACKAGE_EFL=y
BR2_PACKAGE_EFL_BULLET=y
BR2_PACKAGE_EFL_FB=y
BR2_PACKAGE_EFL_WAYLAND=y
BR2_PACKAGE_EFL_JPEG=y
BR2_PACKAGE_EFL_TIFF=y
BR2_PACKAGE_EFL_WEBP=y
BR2_PACKAGE_EFL_LIBRAW=y
BR2_PACKAGE_EFL_SVG=y
BR2_PACKAGE_FB_TEST_APP=y
BR2_PACKAGE_FBSET=y
```

## package/expo/Config.in
```kconfig
menuconfig BR2_PACKAGE_EXPO
	bool "EXPO_bool"
	help
	  Program for show on exhibition for board of DIASOM-RK3568
```

## package/rockchip/Config.in
```kconfig
menuconfig BR2_PACKAGE_ROCKCHIP
	bool "Rockchip Platform"

if BR2_PACKAGE_ROCKCHIP

menu "Rockchip BSP packages"
	source "$BR2_EXTERNAL_DT_PATH/package/rockchip/gstreamer1-rockchip/Config.in"
	source "$BR2_EXTERNAL_DT_PATH/package/rockchip/rockchip-mpp/Config.in"
endmenu

endif
```

## package/testing/Config.in
```kconfig
config BR2_PACKAGE_TESTING
	bool "testing hardware peripheral tester"
	help
	  Hardware test application for Diasom RK SoCs (rk3568, rk3588).
	  Provides CLI and Qt/QML GUI runners for board bring-up tests
	  (CAN, GPIO, UART, filesystem, camera, etc.).

if BR2_PACKAGE_TESTING

choice
	prompt "Target SoC for testing GUI/config"
	default BR2_PACKAGE_TESTING_SOC_RK3568

config BR2_PACKAGE_TESTING_SOC_RK3568
	bool "rk3568"

config BR2_PACKAGE_TESTING_SOC_RK3588
	bool "rk3588"

endchoice

comment "Runtime dependencies (enable in Buildroot menuconfig)"

comment "Qt5 / graphics"
comment "  BR2_PACKAGE_QT5"
comment "  BR2_PACKAGE_QT5DECLARATIVE"

comment "Multimedia"
comment "  BR2_PACKAGE_GSTREAMER1"
comment "  BR2_PACKAGE_GSTREAMER1_PLUGINS_BASE"

comment "Logging / GPIO"
comment "  BR2_PACKAGE_SPDLOG"
comment "  BR2_PACKAGE_LIBGPIODCXX"

endif
```
